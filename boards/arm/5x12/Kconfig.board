## boards/arm/5x12/Kconfig.board
```kconfig
# 5x12 board configuration

# Copyright (c) 2023 HeeChan Kang
# SPDX-License-Identifier: MIT

config BOARD_5x12
    bool "ILabs Challenger 840"
    depends on SOC_NRF52840_QIAA
```

## boards/arm/breonic/Kconfig.board
```kconfig
# Breonic board configuration

# Copyright (c) 2023 HeeChan Kang
# SPDX-License-Identifier: MIT

config BOARD_BREONIC
    bool "Breonic"
    depends on SOC_NRF52840_QIAA
```

## boards/arm/breonic/Kconfig.defconfig
```kconfig
# Copyright (c) 2023 HeeChan Kang
# SPDX-License-Identifier: MIT

if BOARD_BREONIC

config BOARD
    default "breonic"

config ZMK_KEYBOARD_NAME
    default "Breonic"

if USB

config USB_NRFX
    default y

config USB_DEVICE_STACK
    default y

endif # USB

config BT_CTLR
    default BT

config ZMK_BLE
    default y

config ZMK_USB
    default y

endif # BOARD_BREONIC
```
